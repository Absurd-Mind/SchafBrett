#include "EEPROM.h"
#include "cc1101.h"

#define LEDOUTPUT        4       // Connect led to digital pin 4
#define RFCHANNEL        0       // Let's use channel 0
#define SYNCWORD1        0xB5    // Synchronization word, high byte
#define SYNCWORD0        0x47    // Synchronization word, low byte
#define SOURCE_ADDR      4       // Sender address
#define DESTINATION_ADDR 5       // Receiver address

bool debug = false;
bool debugSerial = false;

CC1101 cc1101;      // radio object
CCPACKET txPacket;  // packet object
byte count = 0;

/**
 * This function is called whenever a wireless packet is received
 */
void rfPacketReceived(void)
{
  CCPACKET packet;
    
  // Disable wireless reception interrupt
  detachInterrupt(0);
  if(cc1101.receiveData(&packet) > 0)
  {
//    Serial.println("receiving data");
    if (packet.crc_ok/* && packet.length > 1*/)
    {
      // The LED will toggle when a new packet is received
      //digitalWrite(LEDOUTPUT, !digitalRead(LEDOUTPUT));

      // packet.data[0];   // Our source address
      // packet.data[1];   // Self-incrementing value generated by the sender
      // packet.data[2];   // Self-incrementing value generated by the sender
      // ...
      if (debugSerial) {
        Serial.println("packet");
        Serial.println(packet.data[1]);
        Serial.println(packet.data[2]);
      }
    }
  }

  // Enable wireless reception interrupt
  attachInterrupt(0, rfPacketReceived, FALLING);
}



void setup(){
    while(!Serial){
      delay(100); 
    }
    Serial.begin(9600);


  // Init RF IC
  cc1101.init();
  cc1101.setChannel(RFCHANNEL, false);
  byte sw[] = {SYNCWORD1, SYNCWORD0};
  cc1101.setSyncWord(sw, false);
  cc1101.setDevAddress(SOURCE_ADDR, false);

  // Let's disable address check for the current project so that our device
  // will receive packets even not addressed to it.
  cc1101.disableAddressCheck();
  if (!debug) {
//    attachInterrupt(0, rfPacketReceived, FALLING);
  }
}

int dest = 0;

void loop()
{
  if(Serial.available()){
    if(Serial.peek() == 'k'){
      Serial.read();
      
      int c = Serial.parseInt();
      int v = Serial.parseInt();
      
      Serial.print("switching channel ");
      Serial.print(c);
      Serial.print(" to value ");
      Serial.println(v);
      
      txPacket.length = 4;  // Let's send a single data byte plus the destination address

      // Data payload:
      txPacket.data[0] = dest;   // First data byte has to be the destination address
      txPacket.data[1] = 1;            // Self-incrementing value
      txPacket.data[2] = c;            // Self-incrementing value
      txPacket.data[3] = v;            // Self-incrementing value
      cc1101.sendData(txPacket);             // Transmit packet
      Serial.println("sending finished.");
    } else if (Serial.peek() == 'd') {
      Serial.read();
      dest = Serial.parseInt();
    } else if (Serial.peek() == 'r') {
      Serial.read();
      Serial.println("sending rgb");
      int rk = Serial.parseInt();
      int gk = Serial.parseInt();
      int bk = Serial.parseInt();
      int r = Serial.parseInt();
      int g = Serial.parseInt();
      int b = Serial.parseInt();
     
      txPacket.length = 8;
      
      txPacket.data[0] = dest;   // First data byte has to be the destination address
      txPacket.data[1] = 3;            // Self-incrementing value
      txPacket.data[2] = rk;            // Self-incrementing value
      txPacket.data[3] = gk;            // Self-incrementing value
      txPacket.data[4] = bk;            // Self-incrementing value
      txPacket.data[5] = r;            // Self-incrementing value
      txPacket.data[6] = g;            // Self-incrementing value
      txPacket.data[7] = b;            // Self-incrementing value
      cc1101.sendData(txPacket);             // Transmit packet
    } else if (Serial.peek() == 'm') {
      Serial.read();
      int value = Serial.parseInt();
      int n = Serial.parseInt();
     
      txPacket.length = 4+n;
      
      txPacket.data[0] = dest;   // First data byte has to be the destination address
      txPacket.data[1] = 2;            // Self-incrementing value
      txPacket.data[2] = value;            // Self-incrementing value
      txPacket.data[3] = n;            // Self-incrementing value

      for (int i = 0; i < n; i++) {
          txPacket.data[4+i] = Serial.parseInt();
      }

      cc1101.sendData(txPacket);             // Transmit packet
    } else if (Serial.peek() == 'c') {
      Serial.read();
      int r = Serial.parseInt();
      int g = Serial.parseInt();
      int b = Serial.parseInt();
      int n = Serial.parseInt();
     
      txPacket.length = 6+n*3;
      
      txPacket.data[0] = dest;   // First data byte has to be the destination address
      txPacket.data[1] = 4;            // Self-incrementing value
      txPacket.data[2] = r;
      txPacket.data[3] = g;
      txPacket.data[4] = b;
      // Self-incrementing value
      txPacket.data[5] = n;            // Self-incrementing value

      for (int i = 0; i < n; i++) {
          txPacket.data[6+i*3] = Serial.parseInt();
          txPacket.data[7+i*3] = Serial.parseInt();
          txPacket.data[8+i*3] = Serial.parseInt();
      }

      cc1101.sendData(txPacket);             // Transmit packet
    } else if (Serial.peek() == 'f') {
      Serial.read();
      int freq = Serial.parseInt();
      int brig = Serial.parseInt();

      txPacket.length = 4;
      
      txPacket.data[0] = dest;   // First data byte has to be the destination address
      txPacket.data[1] = 5;            // Self-incrementing value
      txPacket.data[2] = freq;            // Self-incrementing value
      txPacket.data[3] = brig;            // Self-incrementing value
      cc1101.sendData(txPacket);             // Transmit packet
    } else if (Serial.peek() == 'o') {
      Serial.read();
      Serial.println("sending off");
      txPacket.length = 2;
      txPacket.data[0] = dest;   // First data byte has to be the destination address
      txPacket.data[1] = 6;            // Self-incrementing value
      cc1101.sendData(txPacket);             // Transmit packet
    }
    

    while (Serial.read() >= 0){
      ; // flush remaining characters
    }
  }
}


